## Config.in
```kconfig
source "$BR2_EXTERNAL_POCKETPILL_PATH/package/ppgfxtest/Config.in"
source "$BR2_EXTERNAL_POCKETPILL_PATH/package/ppkeys/Config.in"

source "$BR2_EXTERNAL_POCKETPILL_PATH/package/retrofe/Config.in"
source "$BR2_EXTERNAL_POCKETPILL_PATH/package/gnuboy/Config.in"
source "$BR2_EXTERNAL_POCKETPILL_PATH/package/gpsp/Config.in"
```

## package/gpsp/Config.in
```kconfig
config BR2_PACKAGE_GPSP
	bool "gpsp"
	default y
	select BR2_PACKAGE_SDL
	select BR2_PACKAGE_SDL_IMAGE_PNG
	select BR2_PACKAGE_SDL_IMAGE_JPEG
	select BR2_PACKAGE_SDL_IMAGE
	select BR2_PACKAGE_SDL_MIXER
	select BR2_PACKAGE_SDL_TTF
	select BR2_PACKAGE_ZLIB
	select BR2_PACKAGE_INIH
	help
	  Gameboy Advance emulator for Playstation Portable

	  https://github.com/FoxCunning/gpsp.git
```

## package/ppgfxtest/Config.in
```kconfig
config BR2_PACKAGE_PPGFXTEST
	bool "ppgfxtest"
	default y
    select BR2_PACKAGE_SDL2_DIRECTFB
	select BR2_PACKAGE_SDL2
	select BR2_PACKAGE_SDL2_IMAGE
	select BR2_PACKAGE_SDL2_TTF
    select BR2_PACKAGE_SDL2_GFX
	select BR2_PACKAGE_LIBGLIB2
	help
        SDL + directfb test tool
```

## package/ppkeys/Config.in
```kconfig
config BR2_PACKAGE_PPKEYS
	bool "ppkeys"
	depends on BR2_LINUX_KERNEL
	help
		ppkeys
```

## package/retrofe/Config.in
```kconfig
config BR2_PACKAGE_RETROFE
	bool "RetroFE retro game front-end"
	default y
	select BR2_PACKAGE_GSTREAMER1
	select BR2_PACKAGE_GST1_PLUGINS_BASE
	select BR2_PACKAGE_LIBGLIB2
    select BR2_PACKAGE_SDL2_DIRECTFB
	select BR2_PACKAGE_SDL2_FBCON
	select BR2_PACKAGE_SDL2
	select BR2_PACKAGE_SDL2_IMAGE
	select BR2_PACKAGE_SDL2_MIXER
	select BR2_PACKAGE_SDL2_TTF
    select BR2_PACKAGE_SDL2_GFX
	select BR2_PACKAGE_SQLITE
	select BR2_PACKAGE_ZLIB
	help
	  RetroFE is a front-end, which can be used as a graphical
	  user interface to display, select and launch your games,
	  videos, and programs. Its most common usage is for game
	  emulation. RetroFE allows you to define collections, which
	  can be displayed using a menu structure with additional
	  artwork like video, box art, screenshots, etc.

	  https://bitbucket.org/phulshof/retrofe
```

## package/vba/Config.in
```kconfig
config BR2_PACKAGE_VBA
	bool "visualboyadvance-m GBA Emulator"
	default y
    select BR2_PACKAGE_SDL2_DIRECTFB
	select BR2_PACKAGE_SDL2_FBCON
	select BR2_PACKAGE_SDL2
	select BR2_PACKAGE_SDL2_IMAGE
	select BR2_PACKAGE_SDL2_MIXER
	select BR2_PACKAGE_SDL2_TTF
    select BR2_PACKAGE_SDL2_GFX
	select BR2_PACKAGE_ZLIB
	help
        Visual Boy Advance GBA Emulator

        https://github.com/visualboyadvance-m/visualboyadvance-m
```
